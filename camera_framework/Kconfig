## camera_framework/Kconfig
```kconfig
menuconfig PKG_USING_CAMERA_FRAMEWORK
    bool "Camera drivers"
    default n
    select RT_USING_SYSTEM_WORKQUEUE
    help
      Enable the camera framework package, including the handle layer, the
      sensor drivers and the data-bus backends.

      This is the SF-PKG entry point of the camera_framework package: the
      package is built only when this symbol is 'y' (see SConscript).

      The sensor model and the communication form are NOT selected here any
      more. They live in the SDK camera module menu:
      Board Peripherals -> Camera 1
      (customer/peripherals/camera/Kconfig). The module selects this symbol
      when BSP_USING_CAMERA1 is enabled and a model is chosen, and the package
      reads SENSOR_USING_* / CAMERA_USING_* from that module Kconfig.

if PKG_USING_CAMERA_FRAMEWORK

    config CAMERA_BOARD_HAS_MCLK
        bool
        default y if CAMERA_XCLK_ENABLE
        help
          The board declared that the MCU feeds the sensor MCLK. Internal
          read-only symbol: it exists so the backend does not have to poke at
          board symbols all over the place.

    config CAMERA_XCLK_REQUIRED
        bool
        default y if SENSOR_USING_OV2640 && !CAMERA_USING_ARDUCAM_FIFO
        default y if SENSOR_USING_GC032A
        default y if SENSOR_USING_BF30A2
        help
          The compiled-in sensor cannot run without a master clock. An OV2640
          behind an ArduCam FIFO module is the exception: the module drives the
          sensor from its own oscillator.

    rsource "software/Kconfig"

endif
```

## camera_framework/examples/acpu/project/hcpu/Kconfig.proj
```kconfig
config CUSTOM_MEM_MAP
    bool
    select custom_mem_map
    default y

config CAMERA_SW_ACPU_EXAMPLE
    bool
    default y
    select CAMERA_SW_JPEG
    select CAMERA_SW_JPEG_ENCODER
    select CAMERA_SW_JPEG_DECODER

rsource "../../../../software/Kconfig"
```

## camera_framework/examples/isp/project/Kconfig.proj
```kconfig
config CAMERA_SW_ISP_EXAMPLE_HCPU
    bool
    default y

rsource "../../../software/isp/Kconfig"

config CUSTOM_MEM_MAP
    bool
    select custom_mem_map
    default y
```

## camera_framework/examples/jpeg/project/Kconfig.proj
```kconfig
config CAMERA_SW_JPEG_EXAMPLE_HCPU
    bool
    default y

rsource "../../../software/jpeg/Kconfig"

config CUSTOM_MEM_MAP
    bool
    select custom_mem_map
    default y
```

## camera_framework/software/jpeg/Kconfig
```kconfig
menuconfig CAMERA_SW_JPEG
    bool "Camera software JPEG"
    default y

if CAMERA_SW_JPEG

config CAMERA_SW_JPEG_ENCODER
    bool "BitBank JPEGENC encoder"
    default y

config CAMERA_SW_JPEG_DECODER
    bool "ChaN TJpgDec decoder"
    default y

choice
    prompt "Camera software JPEG execution core"
    default CAMERA_SW_JPEG_RUN_ON_HCPU if CAMERA_SW_JPEG_EXAMPLE_HCPU
    default CAMERA_SW_JPEG_RUN_ON_ACPU if BSP_USING_ACPU
    default CAMERA_SW_JPEG_RUN_ON_HCPU

config CAMERA_SW_JPEG_RUN_ON_HCPU
    bool "HCPU"
    depends on !CAMERA_SW_ACPU_EXAMPLE

config CAMERA_SW_JPEG_RUN_ON_ACPU
    bool "ACPU"
    depends on BSP_USING_ACPU

endchoice

endif
```
